## sdkconfig.defaults
```kconfig
# Performance

CONFIG_FREERTOS_HZ=1000
CONFIG_OPTIMIZATION_LEVEL_RELEASE=y

CONFIG_LOG_DEFAULT_LEVEL_INFO=y
#CONFIG_LOG_MAXIMUM_EQUALS_DEFAULT=y
CONFIG_LOG_MAXIMUM_LEVEL_DEBUG=y

CONFIG_ESP_DEFAULT_CPU_FREQ_MHZ_240=y
CONFIG_ESP_DEFAULT_CPU_FREQ_MHZ=240

# Partition
CONFIG_PARTITION_TABLE_CUSTOM=y
CONFIG_PARTITION_TABLE_FILENAME="partitions.csv"

# for task info
CONFIG_FREERTOS_THREAD_LOCAL_STORAGE_POINTERS=2

# for DRAM overflow issue
CONFIG_ESP_WIFI_ENABLED=n

# Bluetooth Configuration - Disabled for APU-only build
CONFIG_BT_ENABLED=n

# SPI-RAM
CONFIG_SPIRAM=y
CONFIG_SPIRAM_MODE_OCT=y
CONFIG_SPIRAM_USE_CAPS_ALLOC=y
# CONFIG_SPIRAM_USE_MALLOC is not set
CONFIG_SPIRAM_TRY_ALLOCATE_WIFI_LWIP=y
CONFIG_SPIRAM_SPEED_80M=y
# for large static global mem
CONFIG_SPIRAM_ALLOW_BSS_SEG_EXTERNAL_MEMORY=y

# Flash
CONFIG_ESPTOOLPY_FLASHMODE="qio"
CONFIG_ESPTOOLPY_FLASHMODE_QIO=y
CONFIG_ESPTOOLPY_FLASHFREQ="80m"
CONFIG_ESPTOOLPY_FLASHFREQ_80M=y
CONFIG_ESPTOOLPY_FLASHSIZE="16MB"
CONFIG_ESPTOOLPY_FLASHSIZE_16MB=y

#### To be checked...
CONFIG_ESP_MAIN_TASK_AFFINITY_CPU0=y

CONFIG_PM_ENABLE=n

# Performance optimizations (Arduino-compatible)
CONFIG_COMPILER_OPTIMIZATION_PERF=y
CONFIG_COMPILER_OPTIMIZATION_ASSERTIONS_DISABLE=y


# Logging configuration
CONFIG_LOG_DEFAULT_LEVEL_INFO=y
CONFIG_LOG_DEFAULT_LEVEL=3

# Arduino-compatible performance settings
# FreeRTOS optimizations matching Arduino
CONFIG_FREERTOS_IDLE_TASK_STACKSIZE=1024
CONFIG_FREERTOS_WATCHPOINT_END_OF_STACK=y
CONFIG_FREERTOS_USE_TICKLESS_IDLE=n

# SPI driver optimizations for real-time performance
CONFIG_SPI_MASTER_ISR_IN_IRAM=y
CONFIG_SPI_SLAVE_ISR_IN_IRAM=y
```
