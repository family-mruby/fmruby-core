/*
 * The Spinel FFT backend: an AOT-compiled Ruby program called as a library
 * from a task that is not a Spinel task (doc/mic_spectrum/impl_plan.md).
 *
 * Every other Spinel program in this firmware IS the task -- the kernel, the
 * desktop, the editor each own their instance for their lifetime. Here an
 * mruby app task builds an instance beside its own VM, calls the program's
 * entries the way it would call C functions, and tears the instance down.
 * That works because an instance is per-task state (fmrb_spinel_host.h) and
 * mruby's mrb_state knows nothing about it: the two runtimes share the task
 * and nothing else.
 *
 * spinel/fft_kernel.rb is compiled as a Spinel ext program; its generated
 * header declares Init_fft() and the entries as typed C functions. A
 * transform is three calls -- load (the samples as a String), run (timed here,
 * with the clock the C backend uses) and magnitudes (a String back). This
 * file includes that header, so it is compiled with the same flags as the
 * generated program (SPINEL_GEN_TU_FLAGS in main/CMakeLists.txt).
 *
 * The pool: a Spinel instance allocates everything -- objects, GC roots,
 * strings -- from one estalloc region handed to it at creation. FFT_POOL_BYTES
 * is sized for the tables fft_core.rb builds (six arrays of `n` Floats for
 * n=1024, plus the strings crossing the boundary) with room for the collector
 * to work in, and it comes out of the calling task's own heap, so a benchmark
 * that is never run costs nothing.
 */

#include <stdint.h>
#include <string.h>

#include "fmrb_fft_spinel.h"
#include "fmrb_fft_bench.h"

#ifdef FMRB_FFT_SPINEL

#include "fft_kernel.h"   /* generated by rake spinel:gen */
#include "fmrb_app.h"
#include "fmrb_log.h"
#include "fmrb_mem.h"
#include "fmrb_spinel_host.h"

/* Placement for this file's statics: the instance handles and a timing, each
   read a few times per run(). Internal DRAM is the scarce resource, so on
   ESP32 they go to PSRAM; on the Linux build it is plain BSS. Same shape as
   FMRB_SPX_BSS_ATTR. */
#ifdef CONFIG_IDF_TARGET_LINUX
#define FFT_SPX_BSS_ATTR
#else
#include "esp_attr.h"
#define FFT_SPX_BSS_ATTR EXT_RAM_BSS_ATTR
#endif

static const char *TAG = "fft_spx";

/* Pool for the Spinel instance. 1024 points needs six Float arrays of 1024
   (~8KB each once boxed) plus the sample and magnitude Strings; 192KB leaves
   the collector room to run rather than thrash. Measured, not guessed: see
   doc/mic_spectrum/report/. */
#define FFT_POOL_BYTES (192 * 1024)

/* The instance and the app task that owns it (fmrb_spinel_host.h): the
   instance is current on the task that called begin(), so that task owns it
   until it calls end() or ends; begin() from another task answers
   FMRB_FFT_SPINEL_BUSY. Zeroed storage (a BSS section); name and pool_free
   are filled in by begin(). */
static void fft_pool_free(void *p) { fmrb_sys_free(p); }
FFT_SPX_BSS_ATTR static fmrb_spinel_gem_t s_gem;
FFT_SPX_BSS_ATTR static uint32_t s_total_us;   /* the whole run(), not just the transform */

/* Every call into the program goes through Init_fft_try: a Ruby raise that
   escapes it would otherwise end the whole firmware. */
typedef struct {
    const char *samples;
    int         n;
    int         iters;
    int         q15;
    const char *mag;
} fft_call_t;

static void fft_init(void *p) { (void)p; Init_fft(); }

static void fft_load(void *p)
{
    fft_call_t *c = (fft_call_t *)p;
    if (c->q15) sp_FftKernel_s_load_q15(c->samples, c->n);
    else        sp_FftKernel_s_load(c->samples, c->n);
}

static void fft_run(void *p)
{
    fft_call_t *c = (fft_call_t *)p;
    if (c->q15) sp_FftKernel_s_run_q15(c->iters);
    else        sp_FftKernel_s_run(c->iters);
}

static void fft_mags(void *p)
{
    fft_call_t *c = (fft_call_t *)p;
    c->mag = c->q15 ? sp_FftKernel_s_magnitudes_q15() : sp_FftKernel_s_magnitudes();
}

static int fft_try(void (*fn)(void *), void *arg, const char *what)
{
    const char *cls = NULL, *msg = NULL;
    if (Init_fft_try(fn, arg, &cls, &msg)) {
        FMRB_LOGE(TAG, "%s raised %s: %s", what, cls ? cls : "?", msg ? msg : "");
        return -1;
    }
    return 0;
}

int fmrb_fft_spinel_available(void)
{
    return 1;
}

int fmrb_fft_spinel_begin(int size)
{
    if (size < 64 || size > FMRB_FFT_MAX_N || (size & (size - 1)) != 0) {
        return -1;
    }
    void *me = (void *)fmrb_task_get_current();
    fmrb_app_task_context_t *app = fmrb_current();
    s_gem.name = "fft";              /* constants: harmless if two tasks race */
    s_gem.pool_free = fft_pool_free;
    int claim = fmrb_spinel_gem_claim(&s_gem, me, app ? (int)app->app_id : -1,
                                      app ? app->app_name : "?");
    if (claim == FMRB_SPINEL_GEM_MINE) {
        return 0;   /* already up; the size travels per run */
    }
    if (claim == FMRB_SPINEL_GEM_BUSY) {
        return FMRB_FFT_SPINEL_BUSY;
    }

    s_gem.pool = fmrb_sys_malloc(FFT_POOL_BYTES);
    if (!s_gem.pool) {
        FMRB_LOGE(TAG, "no memory for the Spinel FFT pool (%d bytes)", FFT_POOL_BYTES);
        fmrb_spinel_gem_release(&s_gem);
        return -2;
    }
    /* Same threshold rule as the kernel instance (fmrb_kernel.c): collect early
       so a burst of allocation cannot reach the top of the pool, since
       exhaustion goes through sp_oom_die and takes the firmware with it. */
    size_t threshold = FFT_POOL_BYTES / 32;
    void *est = fmrb_spinel_instance_begin(s_gem.pool, FFT_POOL_BYTES, threshold, threshold);
    if (!est) {
        FMRB_LOGE(TAG, "could not create the Spinel FFT instance");
        fmrb_sys_free(s_gem.pool);
        fmrb_spinel_gem_release(&s_gem);
        return -3;
    }
    s_gem.est = est;
    if (fft_try(fft_init, NULL, "init") != 0) {
        fmrb_spinel_instance_end(est);
        fmrb_sys_free(s_gem.pool);
        fmrb_spinel_gem_release(&s_gem);
        return -4;
    }
    FMRB_LOGI(TAG, "Spinel FFT instance up (%d bytes, size %d)", FFT_POOL_BYTES, size);
    return 0;
}

void fmrb_fft_spinel_note_fallback(const char *backend)
{
    fmrb_app_task_context_t *app = fmrb_current();
    FMRB_LOGI(TAG, "[%s] the Spinel FFT instance belongs to %s (pid %d); "
                   "this app runs on the %s backend instead",
              app ? app->app_name : "?", s_gem.owner_app, s_gem.owner_pid,
              backend ? backend : "?");
}

static uint32_t fft_spinel_run_mode(const int16_t *in, int n, int iters,
                                    int16_t *mag_out, int q15)
{
    if (!in || iters < 1 || !fmrb_spinel_gem_is_open_on(&s_gem, (void *)fmrb_task_get_current())) {
        return 0;
    }
    uint32_t e0 = fmrb_fft_micros();
    /* A Spinel String carries its length in a header in front of the bytes,
       so the samples are copied onto the instance's heap rather than passed
       as a C buffer. */
    fft_call_t c = { sp_str_from_bytes((const char *)in, (size_t)n * 2), n, iters, q15, NULL };
    uint32_t us = 0;
    if (fft_try(fft_load, &c, "load") == 0) {
        /* The transform alone, as the C backend times itself: decode and
           encode stay outside, in load and magnitudes. */
        uint32_t t0 = fmrb_fft_micros();
        int rc = fft_try(fft_run, &c, "run");
        us = fmrb_fft_micros() - t0;
        if (rc == 0 && fft_try(fft_mags, &c, "magnitudes") == 0 && c.mag && mag_out) {
            size_t len = sp_str_byte_len(c.mag);
            if (len > (size_t)n) {
                len = (size_t)n;   /* n/2 int16 = n bytes */
            }
            memcpy(mag_out, c.mag, len);
        }
    }
    s_total_us = fmrb_fft_micros() - e0;
    return us;
}

uint32_t fmrb_fft_spinel_last_total_us(void)
{
    return s_total_us;
}

uint32_t fmrb_fft_spinel_run(const int16_t *in, int n, int iters, int16_t *mag_out)
{
    return fft_spinel_run_mode(in, n, iters, mag_out, 0);
}

uint32_t fmrb_fft_spinel_run_q15(const int16_t *in, int n, int iters, int16_t *mag_out)
{
    return fft_spinel_run_mode(in, n, iters, mag_out, 1);
}

void fmrb_fft_spinel_end(void)
{
    /* Only the owner tears the instance down: the gem's final hook calls this
       from every mruby app's VM as it closes, and an app that never owned the
       instance must not take it from the one that does. */
    if (!fmrb_spinel_gem_is_open_on(&s_gem, (void *)fmrb_task_get_current())) {
        return;
    }
    fmrb_spinel_instance_end(s_gem.est);
    fmrb_sys_free(s_gem.pool);
    fmrb_spinel_gem_release(&s_gem);
}

#else /* no Spinel FFT in this build */

int fmrb_fft_spinel_available(void) { return 0; }
int fmrb_fft_spinel_begin(int size) { (void)size; return -1; }
void fmrb_fft_spinel_note_fallback(const char *backend) { (void)backend; }
void fmrb_fft_spinel_end(void) { }

uint32_t fmrb_fft_spinel_run(const int16_t *in, int n, int iters, int16_t *mag_out)
{
    (void)in; (void)n; (void)iters; (void)mag_out;
    return 0;
}

uint32_t fmrb_fft_spinel_run_q15(const int16_t *in, int n, int iters, int16_t *mag_out)
{
    (void)in; (void)n; (void)iters; (void)mag_out;
    return 0;
}

uint32_t fmrb_fft_spinel_last_total_us(void) { return 0; }

#endif /* FMRB_FFT_SPINEL */
